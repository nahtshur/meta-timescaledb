## conf/layer.conf
```bitbake
# We have a conf and classes directory, add to BBPATH
BBPATH .= ":${LAYERDIR}"

# We have recipes-* directories, add to BBFILES
BBFILES += "${LAYERDIR}/recipes-*/*/*.bb \
            ${LAYERDIR}/recipes-*/*/*.bbappend"

BBFILE_COLLECTIONS += "timescaledb"
BBFILE_PATTERN_timescaledb = "^${LAYERDIR}/"
BBFILE_PRIORITY_timescaledb = "6"

LAYERDEPENDS_timescaledb = "core"
LAYERSERIES_COMPAT_timescaledb = "langdale honister kirkstone"
```
